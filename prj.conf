## CMakeLists.txt
```
# Copyright (c) 2026 borob-engineering
# SPDX-License-Identifier: Apache-2.0

if(CONFIG_UDS_SERVER)

  zephyr_library()

  # Expose internal module header locations to the compilation unit scope
  zephyr_library_include_directories(include/zephyr/canbus)

  # Consolidate all subsystem driver source files within a single unified call
  zephyr_library_sources(
    src/uds_server.c
    src/uds_session.c
    src/uds_security.c
    src/uds_routine.c
    src/uds_reset.c
    src/uds_clear_dtc.c
    src/uds_read_dtc.c
    src/uds_write_did.h
    src/uds_write_did.c
    src/uds_flash_pipeline.c
    src/uds_iocontrol.c
    src/uds_weak_defaults.c
    src/uds_periodic.c
    src/uds_dynamic_did.c
    src/uds_data_storage.c
    src/uds_read_scaling.c
  )

  # Export public interface directory globally to the application layer
  zephyr_include_directories(include)

endif()
```

## Kconfig
```
source "Kconfig.zephyr"
rsource "src/Kconfig.uds"
```

## prj.conf
```kconfig
CONFIG_CAN=y
CONFIG_ISOTP=y
CONFIG_LOG=y
CONFIG_REBOOT=y

# Empfohlen für Multi-Frame UDS Handling
CONFIG_ISOTP_RX_BUF_COUNT=4

CONFIG_UDS_SERVER=y
CONFIG_ENTROPY_GENERATOR=y
CONFIG_UDS_SEC_MAX_FAILED_ATTEMPTS=5
CONFIG_UDS_SEC_LOCKOUT_TIME_MS=30000
```

## app.overlay
```dts
/ {
    chosen {
        zephyr,entropy = &rng; /* Oder wie das Krypto/RNG-Modul in deinem SoC .dtsi heißt */
    };
};
```

## src/app_uds_implementation.c
```c
/**
 * @file app_uds_implementation.c
 * @brief Konkrete Applikationslogik (Überschreibt die __weak Definitionen)
 */

#include "uds_app_interface.h"
#include <string.h>
#include <errno.h>

#define DID_VIN        0xF190
#define DID_STATUS_LED 0x0123
#define RID_ERASE_FLASH 0xFF00

static uint8_t app_vin[17] = "ZEPHYRISANRTOS123";
static uint8_t app_led_state = 0;

/* Implementierung: DID Lesen */
int uds_app_read_did(uint16_t did, uint8_t *data_out, size_t *len_out, size_t max_len)
{
    if (did == DID_VIN) {
        if (max_len < 17) return -ENOMEM;
        memcpy(data_out, app_vin, 17);
        *len_out = 17;
        return 0;
    }
    return -ENOENT; /* Reicht der Core als NRC 0x31 (RequestOutOfRange) weiter */
}

/* Implementierung: DID Schreiben */
int uds_app_write_did(uint16_t did, const uint8_t *data_in, size_t len)
{
    if (did == DID_VIN) {
        if (len != 17) return -EINVAL; /* Reicht Core als NRC 0x13 (IncorrectLength) weiter */
        memcpy(app_vin, data_in, 17);
        return 0;
    }
    return -ENOENT;
}

/* Implementierung: Key-Berechnung für Security Access Level 1 */
uint32_t uds_app_calculate_key(const uint8_t *seed, size_t len)
{
    if (len < 4) return 0;
    uint32_t seed_val = ((uint32_t)seed[0] << 24) | ((uint32_t)seed[1] << 16) | 
                        ((uint32_t)seed[2] << 8)  | (uint32_t)seed[3];
    
    return seed_val ^ CONFIG_UDS_SEC_SECRET_MASK;
}

/* Implementierung: Stellgliedtest */
int uds_app_io_control(uint16_t did, uint8_t control_param, const uint8_t *control_state, size_t state_len, uint8_t *status_out)
{
    if (did == DID_STATUS_LED) {
        if (control_param == 0x00) { /* returnControlToECU */
            *status_out = app_led_state;
            return 0;
        } else if (control_param == 0x03) { /* shortTermAdjustment */
            if (state_len < 1) return -EINVAL;
            app_led_state = control_state[0];
            *status_out = app_led_state;
            return 0;
        }
        return -EOPNOTSUPP;
    }
    return -ENOENT;
}

/* Implementierung: Routine-Start */
int uds_app_routine_start(uint16_t routine_id, uint8_t *info_out)
{
    if (routine_id == RID_ERASE_FLASH) {
        *info_out = 0x01; /* Routine läuft an */
        return 0;
    }
    return -ENOENT;
}

/* Implementierung: Routine-Ergebnis abfragen */
int uds_app_routine_request_results(uint16_t routine_id, uint8_t *status_out, uint8_t *exit_info_out)
{
    if (routine_id == RID_ERASE_FLASH) {
        *status_out = 0x00; /* Fertig */
        *exit_info_out = 0x00; /* Erfolg */
        return 0;
    }
    return -ENOENT;
}
```

## src/uds_clear_dtc.c
```c
/*
 * Copyright (c) 2026 borob-engineering
 *
 * SPDX-License-Identifier: Apache-2.0
 */

/**
 * @file
 * @brief UDS Service 0x14 (Clear Diagnostic Information) with hardware NVS execution.
 */

#include "uds_clear_dtc.h"
#include "uds_app_interface.h"
#include <zephyr/kernel.h>
#include <zephyr/logging/log.h>
#include <zephyr/kvss/nvs.h>
#include <errno.h>

LOG_MODULE_DECLARE(uds_server, LOG_LEVEL_INF);

#define UDS_NRC78_PERIOD_MS 20

static struct k_work clear_dtc_work;
static struct k_timer nrc78_timer;

static uint32_t target_dtc_group;
static uint8_t stored_sid = 0x14;
static volatile bool worker_done;

static void (*stored_send_cb)(const uint8_t *, size_t);
static void (*stored_nrc_cb)(uint8_t, uint8_t);

static void nrc78_timer_expiry_cb(struct k_timer *timer)
{
	ARG_UNUSED(timer);
	if (worker_done) {
		return;
	}
	if (stored_nrc_cb != NULL) {
		stored_nrc_cb(stored_sid, UDS_NRC_RESPONSE_PENDING);
	}
	if (!worker_done) {
		k_timer_start(&nrc78_timer, K_MSEC(UDS_NRC78_PERIOD_MS), K_NO_WAIT);
	}
}

static void clear_dtc_worker_handler(struct k_work *work)
{
	uint8_t local_tx_buf[] = {0x54};
	struct nvs_fs *fs;
	int ret;

	ARG_UNUSED(work);
	LOG_INF("Asynchronous persistent NVS DTC clearance loop active...");
	
	fs = uds_app_get_nvs_context();
	if (fs != NULL) {
		ret = uds_app_clear_persistent_dtcs(fs, target_dtc_group);
		if (ret != 0) {
			LOG_ERR("Application flash memory clearing failed: %d", ret);
		}
	}

	worker_done = true;
	k_timer_stop(&nrc78_timer);
	k_msleep(10);

	LOG_INF("Persistent clearance finished. Transmitting confirmation frame.");

	if (stored_send_cb != NULL) {
		stored_send_cb(local_tx_buf, sizeof(local_tx_buf));
	}
}

void uds_clear_dtc_init(void)
{
	k_work_init(&clear_dtc_work, clear_dtc_worker_handler);
	k_timer_init(&nrc78_timer, nrc78_timer_expiry_cb, NULL);
}

void uds_clear_dtc_handle(uint8_t *req, size_t len, 
                          void (*send_cb)(const uint8_t *, size_t), 
                          void (*nrc_cb)(uint8_t, uint8_t))
{
	uint8_t sid = req[0];
	
	if (len != 4) {
		nrc_cb(sid, UDS_NRC_INCORRECT_LENGTH_OR_INVALID_FORMAT);
		return;
	}

	if (k_work_is_pending(&clear_dtc_work)) {
		nrc_cb(sid, UDS_NRC_CONDITIONS_NOT_CORRECT);
		return;
	}

	target_dtc_group = ((uint32_t)req[1] << 16) | 
	                   ((uint32_t)req[2] << 8)  | 
	                   ((uint32_t)req[3]);

	stored_send_cb = send_cb;
	stored_nrc_cb = nrc_cb;
	stored_sid = sid;
	worker_done = false;

	k_timer_start(&nrc78_timer, K_MSEC(UDS_NRC78_PERIOD_MS), K_NO_WAIT);
	k_work_submit(&clear_dtc_work);
}
```

## src/uds_clear_dtc.h
```c
/*
 * Copyright (c) 2026 borob-engineering
 *
 * SPDX-License-Identifier: Apache-2.0
 */

/**
 * @file
 * @brief Public interface definitions for the UDS Clear DTC service (0x14).
 */

#ifndef ZEPHYR_SRC_UDS_CLEAR_DTC_H_
#define ZEPHYR_SRC_UDS_CLEAR_DTC_H_

#include <stdint.h>
#include <stddef.h>
#include "uds_types.h"

#ifdef __cplusplus
extern "C" {
#endif

/**
 * @brief Initializes the Clear DTC module.
 *
 * This function sets up the asynchronous kernel work objects and timers required
 * for handling Service 0x14 background processing and Response Pending (NRC 0x78) tracking.
 */
void uds_clear_dtc_init(void);

/**
 * @brief Central request handler for UDS Service 0x14 (Clear Diagnostic Information).
 *
 * Parses the incoming frame, validates formatting and execution state, and defers
 * the memory erasure task to the background system work queue if preconditions are met.
 *
 * @param req     Pointer to the raw received UDS request buffer payload.
 * @param len     Length of the request payload in bytes.
 * @param send_cb Pointer to the callback function for transmitting a positive response.
 * @param nrc_cb  Pointer to the callback function for transmitting a negative response code (NRC).
 */
void uds_clear_dtc_handle(uint8_t *req, size_t len,
			  void (*send_cb)(const uint8_t *, size_t),
			  void (*nrc_cb)(uint8_t, uint8_t));

#ifdef __cplusplus
}
#endif

#endif /* ZEPHYR_SRC_UDS_CLEAR_DTC_H_ */
```

## src/uds_data_storage.c
```c
/*
 * Copyright (c) 2026 borob-engineering
 *
 * SPDX-License-Identifier: Apache-2.0
 */

/**
 * @file
 * @brief Implementation of the vehicle data storage component with NVS non-volatile persistence.
 */

#include "uds_data_storage.h"
#include "uds_app_interface.h"
#include <zephyr/kernel.h>
#include <zephyr/logging/log.h>
#include <zephyr/kvss/nvs.h>
#include <string.h>
#include <errno.h>

LOG_MODULE_DECLARE(uds_server, LOG_LEVEL_INF);

/* Reservierte Applikations-NVS-ID für die persistente Speicherung der VIN */
#define NVS_VIN_PARAM_ID 0x0200

/** @brief Active volatile RAM cache mirror holding the current VIN for rapid retrieval. */
static uint8_t vehicle_vin[VIN_SIZE];

void uds_data_storage_init(void)
{
	struct nvs_fs *fs;
	int ret;

	/* Set up standard factory fallback configuration */
	memcpy(vehicle_vin, "ZEPHYRISANRTOS123", VIN_SIZE);

	fs = uds_app_get_nvs_context();
	if (fs != NULL) {
		/* Attempt to retrieve previously persisted VIN string block from NVS flash */
		ret = nvs_read(fs, NVS_VIN_PARAM_ID, vehicle_vin, VIN_SIZE);
		if (ret == VIN_SIZE) {
			LOG_INF("Successfully recovered persistent VIN from flash storage.");
		} else {
			LOG_WRN("No persistent VIN found. Loading factory default fallback.");
		}
	}
}

const uint8_t *uds_data_storage_get_vin(void)
{
	return vehicle_vin;
}

int uds_data_storage_set_vin(const uint8_t *new_vin, size_t len)
{
	struct nvs_fs *fs;
	int ret;

	if (len != VIN_SIZE || new_vin == NULL) {
		return -EINVAL;
	}

	fs = uds_app_get_nvs_context();
	if (fs == NULL) {
		return -ENXIO;
	}

	/* 1. Synchronize incoming stream payload directly to physical flash sectors via NVS hook */
	ret = uds_app_write_persistent_data(fs, NVS_VIN_PARAM_ID, new_vin, VIN_SIZE);
	if (ret != 0) {
		LOG_ERR("Failed to persist new VIN identifier block to non-volatile flash: %d", ret);
		return -EIO;
	}

	/* 2. Update local runtime mirror cache upon successful flash operation */
	memcpy(vehicle_vin, new_vin, VIN_SIZE);
	LOG_INF("VIN successfully updated in flash memory and active RAM cache.");

	return 0;
}
```

## src/uds_data_storage.h
```c
/*
 * Copyright (c) 2026 borob-engineering
 *
 * SPDX-License-Identifier: Apache-2.0
 */

/**
 * @file
 * @brief Public interface for the central vehicle data RAM storage component.
 */

#ifndef ZEPHYR_SRC_UDS_DATA_STORAGE_H_
#define ZEPHYR_SRC_UDS_DATA_STORAGE_H_

#include <stdint.h>
#include <stddef.h>
#include "uds_types.h"

#ifdef __cplusplus
extern "C" {
#endif

/**
 * @brief Initializes the volatile internal data storage.
 *
 * Populates global non-volatile fields with factory default fallback strings
 * during the early firmware boot up routine.
 */
void uds_data_storage_init(void);

/**
 * @brief Retrieves a pointer to the active Vehicle Identification Number (VIN).
 *
 * @return Const pointer to the 17-byte raw VIN memory area.
 */
const uint8_t *uds_data_storage_get_vin(void);

/**
 * @brief Updates the active Vehicle Identification Number (VIN) inside internal RAM.
 *
 * @param new_vin Pointer to the buffer containing the new 17-byte identification string.
 * @param len     Length of the new VIN block buffer.
 *
 * @retval 0       On success.
 * @retval -EINVAL Invalid buffer length or null pointer assignment.
 */
int uds_data_storage_set_vin(const uint8_t *new_vin, size_t len);

#ifdef __cplusplus
}
#endif

#endif /* ZEPHYR_SRC_UDS_DATA_STORAGE_H_ */
```

## src/uds_dynamic_did.c
```c
/*
 * Copyright (c) 2026 borob-engineering
 *
 * SPDX-License-Identifier: Apache-2.0
 */

/**
 * @file
 * @brief Implementation of UDS Service 0x2C (Dynamically Define Data Identifier).
 *
 * Provides functions to dynamically group parts of existing Data Identifiers (DIDs)
 * into a single custom dynamic DID structure, accelerating structured data retrieval.
 */

#include <zephyr/kernel.h>
#include <string.h>
#include <errno.h>
#include "uds_types.h"
#include "uds_app_interface.h"

/**
 * @brief Representation of a single dynamic DID source slicing reference.
 */
typedef struct {
	/** Source Data Identifier to slice bytes from */
	uint16_t source_did;
	/** 1-based start byte position within the source data array */
	uint8_t position;
	/** Number of sequential bytes to copy from the source data */
	uint8_t length;
} dynamic_entry_t;

/**
 * @brief Map layout connecting a dynamic DID to its underlying source segments.
 */
typedef struct {
	/** The newly created 16-bit virtual Dynamic Data Identifier */
	uint16_t dyn_did;
	/** Array containing source slice mapping configuration rules */
	dynamic_entry_t entries[4];
	/** Count of active slice mapping entries assigned to this DID */
	uint8_t entry_count;
} dynamic_did_map_t;

/** @brief Active volatile dynamic DID configuration mapping table. */
static dynamic_did_map_t dyn_map;

/**
 * @brief Requests processing for defining a dynamic Data Identifier (Service 0x2C).
 *
 * @param req     Pointer to the raw received request byte stream.
 * @param len     Length of the incoming byte stream.
 * @param send_cb Callback reference to emit a positive response frame.
 * @param nrc_cb  Callback reference to emit an error state code.
 */
void uds_handle_define_dynamic_did(uint8_t *req, size_t len,
				   void (*send_cb)(const uint8_t *, size_t),
				   void (*nrc_cb)(uint8_t, uint8_t))
{
	uint8_t sid = req[0];
	uint8_t sub_function;
	uint8_t pos_buf[4];

	if (len < 9) {
		nrc_cb(sid, UDS_NRC_INCORRECT_LENGTH_OR_INVALID_FORMAT);
		return;
	}

	sub_function = req[1];
	if (sub_function != 0x01) {
		nrc_cb(sid, UDS_NRC_SUB_FUNCTION_NOT_SUPPORTED);
		return;
	}

	dyn_map.dyn_did = ((uint16_t)req[2] << 8) | req[3];
	dyn_map.entries[0].source_did = ((uint16_t)req[4] << 8) | req[5];
	dyn_map.entries[0].position = req[6];
	dyn_map.entries[0].length = req[7];
	dyn_map.entry_count = 1;

	pos_buf[0] = 0x6C; /* SID 0x2C + 0x40 */
	pos_buf[1] = sub_function;
	pos_buf[2] = req[2];
	pos_buf[3] = req[3];

	send_cb(pos_buf, sizeof(pos_buf));
}

/**
 * @brief Constructs the composite data payload of a configured dynamic DID.
 *
 * @param did     The requested dynamic 16-bit DID to assemble.
 * @param buf_out Output buffer where sliced source segments should be stored.
 * @param len_out Pointer to write the accumulated size of the compiled payload.
 *
 * @retval 0       On success.
 * @retval -ENOENT Requested identifier is not configured or maps to an inactive entry.
 */
int uds_read_dynamic_did_payload(uint16_t did, uint8_t *buf_out, size_t *len_out)
{
	size_t total_len = 0;
	uint8_t temp_src_buf[64];
	size_t src_len;
	int i;
	int ret;

	if (dyn_map.dyn_did != did || dyn_map.entry_count == 0) {
		return -ENOENT;
	}

	for (i = 0; i < dyn_map.entry_count; i++) {
		ret = uds_app_read_did(dyn_map.entries[i].source_did, temp_src_buf,
				       &src_len, sizeof(temp_src_buf));
		if (ret == 0) {
			memcpy(&buf_out[total_len],
			       &temp_src_buf[dyn_map.entries[i].position - 1],
			       dyn_map.entries[i].length);
			total_len += dyn_map.entries[i].length;
		}
	}

	*len_out = total_len;
	return 0;
}
```

## src/uds_dynamic_did.h
```c
/*
 * Copyright (c) 2026 borob-engineering
 *
 * SPDX-License-Identifier: Apache-2.0
 */

/**
 * @file
 * @brief Public interface definitions for the UDS Dynamic DID module (Service 0x2C).
 */

#ifndef ZEPHYR_SRC_UDS_DYNAMIC_DID_H_
#define ZEPHYR_SRC_UDS_DYNAMIC_DID_H_

#include <stdint.h>
#include <stddef.h>

#ifdef __cplusplus
extern "C" {
#endif

/**
 * @brief Requests processing for defining a dynamic Data Identifier (Service 0x2C).
 *
 * Parses the incoming request frame, configures the internal mapping layout if formatting
 * matches the supported sub-functions, and transmits the positive response confirmation.
 *
 * @param req     Pointer to the raw received request byte stream.
 * @param len     Length of the incoming byte stream.
 * @param send_cb Callback reference to emit a positive response frame.
 * @param nrc_cb  Callback reference to emit an error state code (NRC).
 */
void uds_handle_define_dynamic_did(uint8_t *req, size_t len,
				   void (*send_cb)(const uint8_t *, size_t),
				   void (*nrc_cb)(uint8_t, uint8_t));

/**
 * @brief Constructs the composite data payload of a configured dynamic DID.
 *
 * Cycles through all configured mapping entries, extracts the respective slices via the
 * application layer DID interface, and aggregates them into the target output buffer.
 *
 * @param did     The requested dynamic 16-bit DID to assemble.
 * @param buf_out Output buffer where sliced source segments should be stored.
 * @param len_out Pointer to write the accumulated size of the compiled payload.
 *
 * @retval 0       On success.
 * @retval -ENOENT Requested identifier is not configured or maps to an inactive entry.
 */
int uds_read_dynamic_did_payload(uint16_t did, uint8_t *buf_out, size_t *len_out);

#ifdef __cplusplus
}
#endif

#endif /* ZEPHYR_SRC_UDS_DYNAMIC_DID_H_ */
```

## src/uds_flash_pipeline.c
```c
/*
 * Copyright (c) 2026 borob-engineering
 *
 * SPDX-License-Identifier: Apache-2.0
 */

/**
 * @file
 * @brief Implementation of UDS Services 0x34, 0x36, and 0x37 for the flashing pipeline.
 *
 * This file contains the complete sequential pipeline logic required for secure and
 * standard-compliant software flashing (firmware updates) on top of physical flash drivers.
 */

#include "uds_flash_pipeline.h"
#include "uds_session.h"
#include "uds_security.h"
#include "uds_app_interface.h"
#include <zephyr/kernel.h>
#include <zephyr/logging/log.h>
#include <string.h>
#include <errno.h>

LOG_MODULE_DECLARE(uds_server, LOG_LEVEL_INF);

/**
 * @brief Internal tracking states of the software flashing sequence.
 */
typedef enum {
	/** Default state, pipeline is locked and inactive */
	FLASH_STATE_IDLE,
	/** Download session negotiated, target memory erased, awaiting binary streaming */
	FLASH_STATE_DOWNLOAD_APPROVED,
	/** Consecutive block data transfer active */
	FLASH_STATE_TRANSFERRING
} flash_state_t;

static flash_state_t pipeline_state = FLASH_STATE_IDLE;
static uint32_t memory_address;
static uint32_t memory_size;
static uint32_t bytes_received;
static uint8_t expected_block_counter = 1;

void uds_flash_pipeline_init(void)
{
	pipeline_state = FLASH_STATE_IDLE;
	memory_address = 0;
	memory_size = 0;
	bytes_received = 0;
	expected_block_counter = 1;
}

void uds_handle_request_download(uint8_t *req, size_t len, uint8_t *tx_buf, 
                                 void (*send_cb)(const uint8_t *, size_t), 
                                 void (*nrc_cb)(uint8_t, uint8_t))
{
	uint8_t sid = req[0];
	uint8_t alf_id;
	uint8_t memory_address_len;
	uint8_t memory_size_len;
	size_t idx;
	int i;
	int ret;

	if (uds_session_get() == UDS_SESSION_DEFAULT) {
		nrc_cb(sid, UDS_NRC_SUB_FUNCTION_NOT_SUPPORTED_IN_ACTIVE_SESS);
		return;
	}

	if (uds_security_get_status() != UDS_SEC_UNLOCKED) {
		nrc_cb(sid, UDS_NRC_SECURITY_ACCESS_DENIED);
		return;
	}

	if (len < 5) {
		nrc_cb(sid, UDS_NRC_INCORRECT_LENGTH_OR_INVALID_FORMAT);
		return;
	}

	alf_id = req[2];
	memory_address_len = alf_id & 0x0F;
	memory_size_len = (alf_id >> 4) & 0x0F;

	if (len != (3 + memory_address_len + memory_size_len)) {
		nrc_cb(sid, UDS_NRC_INCORRECT_LENGTH_OR_INVALID_FORMAT);
		return;
	}

	memory_address = 0;
	idx = 3;
	for (i = 0; i < memory_address_len; i++) {
		memory_address = (memory_address << 8) | req[idx++];
	}

	memory_size = 0;
	for (i = 0; i < memory_size_len; i++) {
		memory_size = (memory_size << 8) | req[idx++];
	}

	LOG_INF("UDS Download Request received. Addr: 0x%08X, Size: %u Bytes",
		memory_address, memory_size);

	/* Clear target area inside physical memory flash before data ingestion */
	ret = uds_app_flash_erase_target(memory_address, memory_size);
	if (ret != 0) {
		LOG_ERR("Hardware flash erasure target failed: %d", ret);
		nrc_cb(sid, UDS_NRC_UPLOAD_DOWNLOAD_NOT_ACCEPTED);
		return;
	}

	bytes_received = 0;
	expected_block_counter = 1;
	pipeline_state = FLASH_STATE_DOWNLOAD_APPROVED;

	tx_buf[0] = sid + 0x40;
	tx_buf[1] = 0x20; 
	tx_buf[2] = (uint8_t)(UDS_BUFF_SIZE >> 8); 
	tx_buf[3] = (uint8_t)(UDS_BUFF_SIZE & 0xFF); 

	send_cb(tx_buf, 4);
}

void uds_handle_transfer_data(uint8_t *req, size_t len, uint8_t *tx_buf, 
                              void (*send_cb)(const uint8_t *, size_t), 
                              void (*nrc_cb)(uint8_t, uint8_t))
{
	uint8_t sid = req[0];
	uint8_t block_counter;
	size_t payload_len;
	uint32_t current_offset;
	int ret;

	if (pipeline_state != FLASH_STATE_DOWNLOAD_APPROVED &&
	    pipeline_state != FLASH_STATE_TRANSFERRING) {
		nrc_cb(sid, UDS_NRC_REQUEST_SEQUENCE_ERROR);
		return;
	}

	if (len < 3) {
		nrc_cb(sid, UDS_NRC_INCORRECT_LENGTH_OR_INVALID_FORMAT);
		return;
	}

	block_counter = req[1];
	if (block_counter != expected_block_counter) {
		nrc_cb(sid, UDS_NRC_WRONG_BLOCK_SEQUENCE_COUNTER);
		return;
	}

	payload_len = len - 2;
	current_offset = memory_address + bytes_received;

	/* Stream the parsed block chunk payload directly into target flash layer memory */
	ret = uds_app_flash_write_block(current_offset, &req[2], payload_len);
	if (ret != 0) {
		LOG_ERR("Writing to flash target failed at offset 0x%08X: %d", current_offset, ret);
		nrc_cb(sid, UDS_NRC_TRANSFER_DATA_SUSPENDED);
		return;
	}

	bytes_received += payload_len;
	expected_block_counter++;
	pipeline_state = FLASH_STATE_TRANSFERRING;

	tx_buf[0] = sid + 0x40;
	tx_buf[1] = block_counter;

	send_cb(tx_buf, 2);
}

void uds_handle_request_transfer_exit(uint8_t *req, size_t len, uint8_t *tx_buf, 
                                      void (*send_cb)(const uint8_t *, size_t), 
                                      void (*nrc_cb)(uint8_t, uint8_t))
{
	uint8_t sid = req[0];

	ARG_UNUSED(len);

	if (pipeline_state != FLASH_STATE_TRANSFERRING) {
		nrc_cb(sid, UDS_NRC_REQUEST_SEQUENCE_ERROR);
		return;
	}

	if (bytes_received < memory_size) {
		LOG_WRN("Warning: Fewer bytes received (%u) than requested via 0x34 (%u)",
			bytes_received, memory_size);
	}

	LOG_INF("Transfer completed successfully. Total %u bytes written to flash.", bytes_received);
	pipeline_state = FLASH_STATE_IDLE;

	tx_buf[0] = sid + 0x40;
	send_cb(tx_buf, 1);
}
```

## src/uds_flash_pipeline.h
```c
/*
 * Copyright (c) 2026 borob-engineering
 *
 * SPDX-License-Identifier: Apache-2.0
 */

/**
 * @file
 * @brief Public interface definitions for the UDS Flashing Pipeline services.
 *
 * Contains handlers for Service 0x34 (Request Download), Service 0x36 (Transfer Data),
 * and Service 0x37 (Request Transfer Exit) used during ECU firmware updates.
 */

#ifndef ZEPHYR_SRC_UDS_FLASH_PIPELINE_H_
#define ZEPHYR_SRC_UDS_FLASH_PIPELINE_H_

#include <stdint.h>
#include <stddef.h>

#ifdef __cplusplus
extern "C" {
#endif

/**
 * @brief Initializes the internal states and pointers of the flashing pipeline.
 */
void uds_flash_pipeline_init(void);

/**
 * @brief Central request handler for UDS Service 0x34 (Request Download).
 *
 * @param req     Pointer to the raw received request buffer payload.
 * @param len     Length of the request payload in bytes.
 * @param tx_buf  Pointer to the shared scratchpad transmission buffer.
 * @param send_cb Pointer to the callback function for transmitting responses.
 * @param nrc_cb  Pointer to the callback function for transmitting NRCs.
 */
void uds_handle_request_download(uint8_t *req, size_t len, uint8_t *tx_buf,
				 void (*send_cb)(const uint8_t *, size_t),
				 void (*nrc_cb)(uint8_t, uint8_t));

/**
 * @brief Central request handler for UDS Service 0x36 (Transfer Data).
 *
 * @param req     Pointer to the raw received request buffer payload.
 * @param len     Length of the request payload in bytes.
 * @param tx_buf  Pointer to the shared scratchpad transmission buffer.
 * @param send_cb Pointer to the callback function for transmitting responses.
 * @param nrc_cb  Pointer to the callback function for transmitting NRCs.
 */
void uds_handle_transfer_data(uint8_t *req, size_t len, uint8_t *tx_buf,
			      void (*send_cb)(const uint8_t *, size_t),
			      void (*nrc_cb)(uint8_t, uint8_t));

/**
 * @brief Central request handler for UDS Service 0x37 (Request Transfer Exit).
 *
 * @param req     Pointer to the raw received request buffer payload.
 * @param len     Length of the request payload in bytes.
 * @param tx_buf  Pointer to the shared scratchpad transmission buffer.
 * @param send_cb Pointer to the callback function for transmitting responses.
 * @param nrc_cb  Pointer to the callback function for transmitting NRCs.
 */
void uds_handle_request_transfer_exit(uint8_t *req, size_t len, uint8_t *tx_buf,
				      void (*send_cb)(const uint8_t *, size_t),
				      void (*nrc_cb)(uint8_t, uint8_t));

#ifdef __cplusplus
}
#endif

#endif /* ZEPHYR_SRC_UDS_FLASH_PIPELINE_H_ */
```

## src/uds_iocontrol.c
```c
/*
 * Copyright (c) 2026 borob-engineering
 *
 * SPDX-License-Identifier: Apache-2.0
 */

/**
 * @file
 * @brief Implementation of UDS Service 0x2F (Input Output Control By Identifier).
 *
 * This file contains the request handler to substitute or bypass physical input/output
 * signals of the ECU through the diagnostic tester link.
 */

#include "uds_iocontrol.h"
#include "uds_session.h"
#include "uds_security.h"
#include "uds_app_interface.h"
#include <zephyr/kernel.h>
#include <errno.h>

void uds_handle_io_control(uint8_t *req, size_t len, uint8_t *tx_buf, 
                           void (*send_cb)(const uint8_t *, size_t), 
                           void (*nrc_cb)(uint8_t, uint8_t))
{
	uint8_t sid;
	uint16_t data_id;
	uint8_t control_param;
	uint8_t output_status;
	int ret;

	if (len == 0 || req == NULL) {
		return;
	}

	sid = req[0];

	if (uds_session_get() != UDS_SESSION_EXTENDED) {
		nrc_cb(sid, UDS_NRC_SUB_FUNCTION_NOT_SUPPORTED_IN_ACTIVE_SESS);
		return;
	}

	if (uds_security_get_status() != UDS_SEC_UNLOCKED) {
		nrc_cb(sid, UDS_NRC_SECURITY_ACCESS_DENIED);
		return;
	}

	if (len < 4) {
		nrc_cb(sid, UDS_NRC_INCORRECT_LENGTH_OR_INVALID_FORMAT);
		return;
	}

	data_id = ((uint16_t)req[1] << 8) | req[2];
	control_param = req[3];
	output_status = 0;

	/* Forward IO request details with optional modifier parameters to the app hook */
	ret = uds_app_io_control(data_id, control_param, &req[4], len - 4, &output_status);

	if (ret == 0) {
		tx_buf[0] = sid + 0x40;
		tx_buf[1] = req[1];
		tx_buf[2] = req[2];
		tx_buf[3] = control_param;
		tx_buf[4] = output_status;
		send_cb(tx_buf, 5);
	} else if (ret == -EINVAL) {
		nrc_cb(sid, UDS_NRC_INCORRECT_LENGTH_OR_INVALID_FORMAT);
	} else if (ret == -ENOENT) {
		nrc_cb(sid, UDS_NRC_REQUEST_OUT_OF_RANGE);
	} else {
		nrc_cb(sid, UDS_NRC_CONDITIONS_NOT_CORRECT);
	}
}
```

## src/uds_iocontrol.h
```c
/*
 * Copyright (c) 2026 borob-engineering
 *
 * SPDX-License-Identifier: Apache-2.0
 */

/**
 * @file
 * @brief Public interface definitions for the UDS IO Control module (Service 0x2F).
 */

#ifndef ZEPHYR_SRC_UDS_IOCONTROL_H_
#define ZEPHYR_SRC_UDS_IOCONTROL_H_

#include <stdint.h>
#include <stddef.h>
#include "uds_types.h"

#ifdef __cplusplus
extern "C" {
#endif

/**
 * @brief Central request handler for UDS Service 0x2F (Input Output Control By Identifier).
 *
 * Validates formatting, checks session and security preconditions, and delegates
 * the actuator control operation to the weak application layer interface hook.
 *
 * @param req     Pointer to the raw received request buffer payload.
 * @param len     Length of the request payload in bytes.
 * @param tx_buf  Pointer to the shared scratchpad transmission buffer.
 * @param send_cb Pointer to the callback function for transmitting a positive response.
 * @param nrc_cb  Pointer to the callback function for transmitting a negative response code (NRC).
 */
void uds_handle_io_control(uint8_t *req, size_t len, uint8_t *tx_buf, 
                           void (*send_cb)(const uint8_t *, size_t), 
                           void (*nrc_cb)(uint8_t, uint8_t));

#ifdef __cplusplus
}
#endif

#endif /* ZEPHYR_SRC_UDS_IOCONTROL_H_ */
```

## src/uds_periodic.c
```c
/*
 * Copyright (c) 2026 borob-engineering
 *
 * SPDX-License-Identifier: Apache-2.0
 */

/**
 * @file
 * @brief Implementation of UDS Service 0x2A (Read Data By Periodic Identifier) via dedicated kernel thread.
 *
 * Manages rapid, cyclic transmission of high-frequency diagnostic variables scheduled
 * inside an independent low-priority background thread execution loop.
 */

#include "uds_periodic.h"
#include "uds_types.h"
#include "uds_app_interface.h"
#include <zephyr/kernel.h>
#include <zephyr/logging/log.h>

LOG_MODULE_REGISTER(uds_periodic, LOG_LEVEL_INF);

/** @brief Active list containing registered periodic diagnostic identifiers. */
static uint8_t active_periodic_dids[5];
/** @brief Current registration density of tracked periodic identifiers. */
static uint8_t active_did_count;
static void (*periodic_send_cb)(const uint8_t *, size_t);

/**
 * @brief Background kernel thread sampling and broadcasting active periodic DIDs.
 *
 * @param p1 Unused thread argument reference.
 * @param p2 Unused thread argument reference.
 * @param p3 Unused thread argument reference.
 */
static void uds_periodic_thread_handler(void *p1, void *p2, void *p3)
{
	uint8_t periodic_tx_buf[16];
	size_t data_len;
	int i;
	int ret;

	ARG_UNUSED(p1);
	ARG_UNUSED(p2);
	ARG_UNUSED(p3);

	for (;;) {
		/* Cyclic sample rate interval cadence: 10 ms */
		k_msleep(10); 

		if (active_did_count == 0 || periodic_send_cb == NULL) {
			continue;
		}

		for (i = 0; i < active_did_count; i++) {
			periodic_tx_buf[0] = 0x2A;
			periodic_tx_buf[1] = active_periodic_dids[i];
			
			ret = uds_app_get_periodic_did(active_periodic_dids[i], &periodic_tx_buf[2], &data_len);
			if (ret == 0) {
				periodic_send_cb(periodic_tx_buf, 2 + data_len);
			}
		}
	}
}

K_THREAD_DEFINE(uds_periodic_id, 1024, uds_periodic_thread_handler, NULL, NULL, NULL, 6, 0, 0);

void uds_handle_periodic_request(uint8_t *req, size_t len,
				 void (*send_cb)(const uint8_t *, size_t),
				 void (*nrc_cb)(uint8_t, uint8_t))
{
	uint8_t sid = req[0];
	uint8_t transmission_mode;
	uint8_t stop_pos_buf[] = {0x6A, 0x04};
	uint8_t start_pos_buf[3];

	periodic_send_cb = send_cb;

	if (len < 3) {
		nrc_cb(sid, UDS_NRC_INCORRECT_LENGTH_OR_INVALID_FORMAT);
		return;
	}

	transmission_mode = req[1];

	if (transmission_mode == 0x04) { /* stopTransmission */
		active_did_count = 0;
		stop_pos_buf[1] = transmission_mode;
		send_cb(stop_pos_buf, sizeof(stop_pos_buf));
		return;
	}

	if (transmission_mode == 0x01) { /* sendAtFastRate */
		if (active_did_count >= 5) {
			nrc_cb(sid, UDS_NRC_REQUEST_OUT_OF_RANGE);
			return;
		}
		active_periodic_dids[active_did_count++] = req[2];
		
		start_pos_buf[0] = 0x6A;
		start_pos_buf[1] = transmission_mode;
		start_pos_buf[2] = req[2];
		send_cb(start_pos_buf, sizeof(start_pos_buf));
	}
}
```
