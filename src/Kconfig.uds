## src/Kconfig.uds
```kconfig
# Copyright (c) 2026 borob-engineering
# SPDX-License-Identifier: Apache-2.0

menu "UDS Server Configuration"

config UDS_SERVER
	bool "Enable UDS Server Subsystem"
	default n
	select CAN
	select ISOTP
	select ENTROPY_GENERATOR
	select REBOOT
	help
	  Enables the generic, modular ISO-TP based UDS Server implementation
	  compatible with ISO 14229-1 over Zephyr RTOS.

if UDS_SERVER

config UDS_BUFF_SIZE
	int "Maximum ISO-TP buffer size"
	default 4095
	range 64 4095
	help
	  Defines the maximum buffer size for UDS RX and TX messages.
	  This also limits the maximum block size reported in Service 0x34.

config UDS_CAN_RX_ID
	hex "UDS CAN Receive ID (Physical Request)"
	default 0x7E0
	help
	  The CAN ID on which the server listens for physical, 
	  node-specific diagnostic requests.

config UDS_CAN_FUNC_RX_ID
	hex "UDS CAN Functional Receive ID (Global Request)"
	default 0x7DF
	help
	  The global/functional CAN ID on which all network nodes 
	  listen simultaneously (e.g., for Tester Present).

config UDS_CAN_TX_ID
	hex "UDS CAN Transmit ID (Physical Response)"
	default 0x7E8
	help
	  The CAN ID used by the server to send diagnostic responses 
	  back to the tester.

config UDS_S3_TIMEOUT_MS
	int "S3 Session Timeout in milliseconds"
	default 5000
	range 1000 10000
	help
	  Time duration without any tester communication (including 3E) 
	  before transitioning back to default session and locking security.

menu "Security Access Settings (Service 0x27)"

config UDS_SEC_MAX_FAILED_ATTEMPTS
	int "Maximum failed attempts"
	default 3
	range 1 10
	help
	  Number of consecutive incorrect security keys allowed before 
	  locking out the tester.

config UDS_SEC_LOCKOUT_TIME_MS
	int "Lockout time in milliseconds"
	default 10000
	range 1000 600000
	help
	  Time duration the diagnostic interface remains locked after 
	  exceeding the maximum allowed failed attempts.

config UDS_SEC_SEED_SIZE
	int "Size of the security seed in bytes"
	default 4
	range 4 32
	help
	  Size of the security seed generated by the hardware RNG.

config UDS_SEC_SECRET_MASK
	hex "Security secret XOR mask"
	default 0xABCDE123
	help
	  Static mask used for the example seed-to-key computation 
	  in the default app implementation.

endmenu # Security Access Settings

endif # UDS_SERVER

endmenu # UDS Server Configuration
```
